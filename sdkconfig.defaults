## sdkconfig.defaults
```kconfig
# Partition Table Configuration
# Use large single app partition (3MB) to fit Black Magic Probe with all targets
CONFIG_PARTITION_TABLE_SINGLE_APP_LARGE=y
CONFIG_PARTITION_TABLE_CUSTOM_FILENAME="partitions.csv"
CONFIG_PARTITION_TABLE_FILENAME="partitions_singleapp_large.csv"
CONFIG_PARTITION_TABLE_OFFSET=0x8000

# Watchdog Timer Configuration
# Disable interrupt and task watchdog timers for debugging
CONFIG_ESP_INT_WDT=n
CONFIG_ESP_TASK_WDT_EN=n

# mDNS Configuration
CONFIG_LWIP_DNS_SUPPORT_MDNS_QUERIES=y
CONFIG_MDNS_MAX_INTERFACES=3
CONFIG_MDNS_MAX_SERVICES=10
CONFIG_MDNS_TASK_PRIORITY=1
CONFIG_MDNS_ACTION_QUEUE_LEN=16
CONFIG_MDNS_TASK_STACK_SIZE=4096
CONFIG_MDNS_TASK_AFFINITY_CPU0=y
CONFIG_MDNS_TASK_AFFINITY=0x0
CONFIG_MDNS_TASK_CREATE_FROM_INTERNAL=y
CONFIG_MDNS_MEMORY_ALLOC_INTERNAL=y
CONFIG_MDNS_SERVICE_ADD_TIMEOUT_MS=2000
CONFIG_MDNS_TIMER_PERIOD_MS=100
CONFIG_MDNS_ENABLE_CONSOLE_CLI=y
CONFIG_MDNS_MULTIPLE_INSTANCE=y
CONFIG_MDNS_PREDEF_NETIF_STA=y

# Wi-Fi Configuration
CONFIG_ESP_WIFI_SSID="myssid"
CONFIG_ESP_WIFI_PASSWORD="mypassword"

# Component Configuration
# Note: WHOLE_ARCHIVE is set in components/esp32-platform/CMakeLists.txt
```
